## config/boards/shields/equals60/Kconfig.defconfig
```kconfig
# Copyright (c) 2021 The ZMK Contributors
# SPDX-License-Identifier: MIT

if SHIELD_EQUALS60

config ZMK_KEYBOARD_NAME
    default "equals60"

endif
```
